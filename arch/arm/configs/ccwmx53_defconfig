## arch/arm/configs/ccwmx53_defconfig
```kconfig
CONFIG_ARM=y
CONFIG_ARM_LINUX=y
CONFIG_ARCH_IMX=y
CONFIG_CPU_32=y
CONFIG_CPU_V7=y
CONFIG_CPU_32v7=y
CONFIG_ARCH_TEXT_BASE=0x7ff00000
CONFIG_BAREBOX_MAX_IMAGE_SIZE=0xffffffff
CONFIG_ARCH_IMX_INTERNAL_BOOT=y
CONFIG_ARCH_IMX_IMXIMAGE=y
CONFIG_ARCH_IMX_INTERNAL_BOOT_NAND=y
CONFIG_ARCH_IMX53=y
CONFIG_MACH_CCWMX53=y
CONFIG_ARCH_IMX_USBLOADER=y
CONFIG_IMX_IIM=y
CONFIG_IMX_IIM_FUSE_BLOW=y
CONFIG_AEABI=y
CONFIG_ARM_OPTIMZED_STRING_FUNCTIONS=y
CONFIG_ARM_EXCEPTIONS=y
CONFIG_ARM_UNWIND=y
CONFIG_DEFCONFIG_LIST="$ARCH_DEFCONFIG"
CONFIG_GREGORIAN_CALENDER=y
CONFIG_HAS_KALLSYMS=y
CONFIG_HAS_MODULES=y
CONFIG_ENV_HANDLING=y
CONFIG_HAS_CACHE=y
CONFIG_HAS_DMA=y
CONFIG_GENERIC_GPIO=y
CONFIG_BOOTM=y
CONFIG_BLOCK=y
CONFIG_BLOCK_WRITE=y
CONFIG_FILETYPE=y
CONFIG_BINFMT=y
CONFIG_UIMAGE=y
CONFIG_GLOBALVAR=y
CONFIG_STDDEV=y

CONFIG_LOCALVERSION=""
CONFIG_LOCALVERSION_AUTO=y
CONFIG_BANNER=y
CONFIG_MEMINFO=y
CONFIG_ENVIRONMENT_VARIABLES=y

CONFIG_HAVE_PBL_IMAGE=y
CONFIG_HAVE_IMAGE_COMPRESSION=y

CONFIG_MMU=y
CONFIG_MMU_EARLY=y
CONFIG_HAVE_CONFIGURABLE_TEXT_BASE=y
CONFIG_TEXT_BASE=0x7ff00000
CONFIG_BAREBOX_MAX_BARE_INIT_SIZE=0xffffffff
CONFIG_STACK_SIZE=0x8000
CONFIG_MALLOC_SIZE=0x2000000

CONFIG_MALLOC_TLSF=y
CONFIG_KALLSYMS=y

CONFIG_PROMPT="barebox:"
CONFIG_BAUDRATE=115200
CONFIG_CBSIZE=1024
CONFIG_SHELL_HUSH=y

CONFIG_GLOB=y

CONFIG_PROMPT_HUSH_PS2="> "
CONFIG_HUSH_FANCY_PROMPT=y
CONFIG_CMDLINE_EDITING=y
CONFIG_AUTO_COMPLETE=y
CONFIG_MENU=y
CONFIG_DYNAMIC_CRC_TABLE=y
CONFIG_ERRNO_MESSAGES=y
CONFIG_TIMESTAMP=y
CONFIG_CONSOLE_FULL=y
# CONFIG_CONSOLE_SIMPLE is not set
# CONFIG_CONSOLE_NONE is not set
CONFIG_CONSOLE_ACTIVATE_FIRST=y
# CONFIG_CONSOLE_ACTIVATE_ALL is not set
# CONFIG_CONSOLE_ACTIVATE_NONE is not set
CONFIG_PARTITION=y
CONFIG_PARTITION_DISK=y
CONFIG_PARTITION_DISK_DOS=y
# CONFIG_PARTITION_DISK_EFI is not set
CONFIG_DEFAULT_ENVIRONMENT=y
# CONFIG_DEFAULT_COMPRESSION_GZIP is not set
CONFIG_DEFAULT_COMPRESSION_LZO=y
# CONFIG_DEFAULT_COMPRESSION_NONE is not set
# CONFIG_DEFAULT_ENVIRONMENT_GENERIC_NEW is not set
CONFIG_DEFAULT_ENVIRONMENT_GENERIC=y
CONFIG_DEFAULT_ENVIRONMENT_PATH="arch/arm/boards/ccwmx53/env"
CONFIG_BAREBOXENV_TARGET=y

CONFIG_POLLER=y
CONFIG_RESET_SOURCE=y

CONFIG_COMPILE_LOGLEVEL=7
CONFIG_DEFAULT_LOGLEVEL=6
# CONFIG_DEBUG_INFO is not set

CONFIG_DEBUG_IMX53_UART=y
CONFIG_DEBUG_IMX_UART_PORT=1
CONFIG_COMMAND_SUPPORT=y
CONFIG_COMPILE_MEMORY=y

CONFIG_CMD_ARM_CPUINFO=y
CONFIG_CMD_DEVINFO=y

CONFIG_CMD_DRVINFO=y
CONFIG_CMD_HELP=y
CONFIG_LONGHELP=y
CONFIG_CMD_IOMEM=y

CONFIG_CMD_MEMINFO=y

CONFIG_CMD_VERSION=y

CONFIG_FLEXIBLE_BOOTARGS=y
CONFIG_CMD_BOOT=y
CONFIG_CMD_BOOTM=y
CONFIG_CMD_BOOTM_SHOW_TYPE=y
CONFIG_CMD_BOOTM_VERBOSE=y
CONFIG_CMD_BOOTM_INITRD=y
CONFIG_CMD_BOOTM_OFTREE=y
CONFIG_CMD_BOOTM_OFTREE_UIMAGE=y
# CONFIG_CMD_BOOTM_AIMAGE is not set
# CONFIG_CMD_BOOTU is not set
CONFIG_CMD_BOOTZ=y
CONFIG_CMD_GO=y
# CONFIG_CMD_LOADB is not set
# CONFIG_CMD_LOADS is not set
# CONFIG_CMD_LOADY is not set
CONFIG_CMD_RESET=y
CONFIG_CMD_UIMAGE=y

#
# Partition
#
CONFIG_CMD_PARTITION=y
CONFIG_CMD_AUTOMOUNT=y
CONFIG_CMD_MOUNT=y
CONFIG_CMD_UMOUNT=y

#
# Environment
#
CONFIG_CMD_NV=y
CONFIG_CMD_EXPORT=y
CONFIG_CMD_DEFAULTENV=y
CONFIG_CMD_GLOBAL=y
CONFIG_CMD_LOADENV=y
CONFIG_CMD_PRINTENV=y
CONFIG_CMD_MAGICVAR=y
CONFIG_CMD_MAGICVAR_HELP=y
CONFIG_CMD_SAVEENV=y
CONFIG_CMD_CAT=y
CONFIG_CMD_CD=y
CONFIG_CMD_CP=y

CONFIG_CMD_LS=y

CONFIG_CMD_MKDIR=y
CONFIG_CMD_PWD=y

CONFIG_CMD_RM=y
CONFIG_CMD_RMDIR=y

CONFIG_CMD_UNCOMPRESS=y

CONFIG_CMD_FALSE=y
CONFIG_CMD_GETOPT=y

CONFIG_CMD_SLEEP=y
CONFIG_CMD_TEST=y
CONFIG_CMD_TRUE=y

CONFIG_CMD_DHCP=y

CONFIG_CMD_PING=y
CONFIG_CMD_TFTP=y

CONFIG_CMD_CLEAR=y
CONFIG_CMD_ECHO=y
CONFIG_CMD_ECHO_E=y
CONFIG_CMD_EDIT=y

CONFIG_CMD_READLINE=y
CONFIG_CMD_TIMEOUT=y

CONFIG_CMD_CRC=y
CONFIG_CMD_CRC_CMP=y
CONFIG_CMD_MD=y
CONFIG_CMD_MEMCMP=y
CONFIG_CMD_MEMCPY=y
CONFIG_CMD_MEMSET=y

CONFIG_CMD_MW=y

CONFIG_CMD_CLK=y
CONFIG_CMD_DETECT=y
CONFIG_CMD_FLASH=y
CONFIG_CMD_GPIO=y
CONFIG_CMD_I2C=y
CONFIG_CMD_NAND=y

CONFIG_CMD_USB=y
CONFIG_CMD_TIME=y

CONFIG_NET=y
CONFIG_NET_NFS=y
CONFIG_NET_NETCONSOLE=y

CONFIG_NET_IFUP=y
CONFIG_NET_DHCP=y

CONFIG_OFTREE=y
CONFIG_OFTREE_MEM_GENERIC=y
CONFIG_DTC=y

CONFIG_OF_NET=y

CONFIG_DRIVER_SERIAL_IMX=y

CONFIG_ARCH_HAS_FEC_IMX=y
CONFIG_PHYLIB=y

CONFIG_DRIVER_NET_FEC_IMX=y
CONFIG_SMSC_PHY=y

CONFIG_I2C=y

CONFIG_I2C_IMX=y
CONFIG_MTD=y
CONFIG_MTD_WRITE=y
CONFIG_MTD_OOB_DEVICE=y
CONFIG_NAND=y
CONFIG_NAND_ECC_SOFT=y

CONFIG_NAND_ECC_HW_NONE=y
CONFIG_NAND_INFO=y
CONFIG_NAND_READ_OOB=y
CONFIG_NAND_BBT=y

CONFIG_NAND_IMX=y
CONFIG_NAND_IMX_BBM=y

CONFIG_MTD_NAND_IDS=y
CONFIG_DISK=y
CONFIG_DISK_WRITE=y
CONFIG_DISK_ATA=y
CONFIG_DISK_AHCI=y
CONFIG_DISK_AHCI_IMX=y
CONFIG_USB=y
CONFIG_USB_HOST=y
CONFIG_USB_IMX_CHIPIDEA=y
CONFIG_USB_EHCI=y
CONFIG_USB_STORAGE=y
CONFIG_MCI=y
CONFIG_MCI_STARTUP=y
CONFIG_MCI_INFO=y
CONFIG_MCI_WRITE=y
CONFIG_MCI_MMC_BOOT_PARTITIONS=y
CONFIG_MCI_IMX_ESDHC=y
CONFIG_HAVE_CLK=y
CONFIG_CLKDEV_LOOKUP=y
CONFIG_COMMON_CLK=y
CONFIG_CLOCKSOURCE_DUMMY_RATE=1000
CONFIG_MFD_DA9053=y
CONFIG_WATCHDOG_IMX_RESET_SOURCE=y
CONFIG_WATCHDOG=y
CONFIG_WATCHDOG_IMX=y
CONFIG_GPIOLIB=y
CONFIG_GPIO_GENERIC=y
CONFIG_GPIO_GENERIC_PLATFORM=y
CONFIG_GPIO_IMX=y
CONFIG_PINCTRL_IMX_IOMUX_V3=y
CONFIG_FS=y
CONFIG_FS_AUTOMOUNT=y
CONFIG_FS_EXT4=y
CONFIG_FS_RAMFS=y
CONFIG_FS_DEVFS=y
CONFIG_FS_TFTP=y
CONFIG_FS_FAT=y
CONFIG_FS_FAT_WRITE=y
CONFIG_FS_FAT_LFN=y
CONFIG_PARAMETER=y
CONFIG_UNCOMPRESS=y
CONFIG_ZLIB=y
CONFIG_PROCESS_ESCAPE_SEQUENCE=y
CONFIG_LZO_DECOMPRESS=y
CONFIG_CRC32=y
```

## arch/arm/mach-imx/Kconfig.rej
```kconfig
--- arch/arm/mach-imx/Kconfig	2015-11-02 19:57:18.187216311 -0800
+++ arch/arm/mach-imx/Kconfig	2015-10-31 15:46:08.386354381 -0700
@@ -27,6 +27,7 @@
 	default 0x7ff00000 if MACH_TQMA53
 	default 0x97f00000 if MACH_TX51
 	default 0x97f00000 if MACH_CCMX51
+	default 0x7ff00000 if MACH_CCWMX53
 	default 0x4fc00000 if MACH_SABRELITE
 	default 0x8fe00000 if MACH_TX53
 	default 0x97f00000 if MACH_EFIKA_MX_SMARTBOOK
@@ -536,6 +537,17 @@
 	bool "Freescale i.MX53 SMD"
 	select ARCH_IMX53
 
+config MACH_CCWMX53
+	bool "ConnectCore i.MX53"
+	select ARCH_IMX53
+	select IMX_IIM
+	select I2C
+	select DRIVER_I2C_IMX
+	select MFD_DA9053
+	help
+	  Say Y here if you are using Digi ConnectCore (W)i-i.MX53
+	  equipped with a Freescale i.MX53 Processor
+	  
 config MACH_TX53
 	bool "Ka-Ro TX53"
 	select ARCH_IMX53
```
